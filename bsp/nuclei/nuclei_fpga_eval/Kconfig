## bsp/nuclei/nuclei_fpga_eval/Kconfig
```kconfig
mainmenu "RT-Thread Configuration"

BSP_DIR := .

RTT_DIR := ../../..

PKGS_DIR := packages

source "$(RTT_DIR)/Kconfig"
osource "$PKGS_DIR/Kconfig"
rsource "board/Kconfig"

config SOC_RISCV_FAMILY_NUCLEI
    bool

config SOC_NUCLEI_EVALSOC
    bool
    ## TODO select RV32 or RV64
    ## according to your real SoC
    # select ARCH_RISCV32
    select ARCH_RISCV
    select ARCH_CPU_64BIT
    # select ARCH_RISCV64
    ## TODO enable ARCH_RISCV_FPU if you
    ## want to save fpu stack during interrupt
    ## exception or context switch
    # select ARCH_RISCV_FPU
    select SOC_RISCV_FAMILY_NUCLEI
    select PKG_USING_NUCLEI_SDK
    select RT_USING_COMPONENTS_INIT
    select RT_USING_USER_MAIN
    select RT_USING_HW_ATOMIC
    default y
```
